## configs/imx6ull_defconfig
```kconfig
# imx6ull specific
CONFIG_ARM=y
CONFIG_ARCH_MX6=y
CONFIG_TEXT_BASE=0x87800000
CONFIG_NR_DRAM_BANKS=1
CONFIG_MX6ULL=y

# device tree
CONFIG_DEFAULT_DEVICE_TREE="imx6ull-raw"
```
